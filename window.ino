/*.
⠄⠄⠄⠸⣿⡛⠷⣦
⢀⣄⠄⠄⠈⠻⣦⡀⢙⣤
⢸⡟⢷⣄⠄⠄⣨⡷⠄⢻⡇
⠘⣷⡀⠙⠷⠾⠋⠄⠄⠺⣧⣀⣴⠶⢶⡄
 ⠈⠻⢶⣤⣤⣤⣄⣀⣀⣼⠟⠁⠄⢠⣿⠶⣦⡀
       ⠈⢩⡿⠋⠙⠛⠷⣦⣴⣟⠁⠄⣸⣧⣤⣄
      ⣰⡟⠁⠄⠄⠄⠄⠄⠉⠛⢷⣾⠋⠄⠄⣿⣤⣄⡀
     ⣼⠏⠄⠄⠄⣠⡶⠶⣶⣤⣤⣾⡃⠄⣠⡾⠋⠄⢙⣷
     ⢿⡄⠄⠄⠄⠉⠁⠄⠈⠻⣿⣌⠻⢿⣿⠄⠄⣠⣾⡇
     ⠈⢿⣆⠄⠄⠄⠄⠄⠄⠄⠈⠻⣷⡀⠻⠷⠾⢿⣼⣧
        ⠙⣷⠄⠄⠄⠄⠄⠄⠄⠄⠈⠻⣧⡀⠄⠄⠙⠛⠛⠛⠷⣦⡀
          ⢿⣄⠄⠄⠄⠄⠄⠄⠄⠄⠈⢻⣦⠄⠄⣠⡶⢷⣄⠈⢿⡄
           ⠹⣧⠄⠄⠄⠄⠄⠄⠄⠄⢸⣿⠄⢼⡋⠄⠄⠙⢷⣼⡇
            ⢹⡇⠄⠄⠄⠄⠄⠄⠄⠄⢻⣆⠈⠻⣦⡀⠄⠄⠙⠃
            ⢸⡇⠄⠄⠄⠄⠄⠄⠄⠄⢸⡟⠻⣶⣬⣿⡆
           ⢠⡾⠿⠿⠿⠿⠿⠿⠿⠿⠿⠿⣧⡀
           ⣿   ЫЫЫ,       ⢸⡇
           ⣿              ⢸⡇
           ⠿  Мы профи    ⠸⠇
*/
//как это работает я писать не буду, я это собрал оно фурычыт
#include <M5StickCPlus2.h>
float accX, accY, accZ;
int x, y, xw, yw;
int w;
float sens = 2.5;
const uint16_t cursoridl [] PROGMEM = {
0xffff, 0xffff, 0xffff, 0xffff,
0xffff, 0xffff, 0xffff, 0x0000,
0xffff, 0xffff, 0xffff, 0xffff,
0xffff, 0x0000, 0xffff, 0xffff
};

uint16_t windbar [] PROGMEM = {
0xc618, 0x9cf4, 0x9cf3, 0x9cd3, 0x9cd3, 0x94d3, 0x9cd3, 0x9cd3, 0x9cd3, 0x9cd3, 0x9cd3, 0x9cd3,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 0x94d3
};
//14
//68
void setup() {
 auto cfg = M5.config();
StickCP2.begin(cfg);
M5.Imu.init();
  Serial.begin(9600);
  M5.Lcd.setRotation(1);
}

void loop() {
  StickCP2.update();
if(StickCP2.BtnA.wasPressed()){
   StickCP2.Speaker.tone(5000, 60);
} 
  M5.Lcd.clear();
  M5.Lcd.setCursor( 5, 5);
  M5.Lcd.setTextColor(WHITE);
  M5.Lcd.setTextSize(1);
  M5.Lcd.println("BtnB - create window");
  M5.Lcd.println("BtnA - standart click");
  M5.Imu.getAccelData(&accX, &accY, &accZ);
 y = map(accY * sens * 10000, -10000, 10000, 0, 240);
 x = map(accX * sens * 10000, -10000, 10000, 0, 135);
 y = constrain(y, 0, 230);
x = constrain(x, 0, 125);
if(w == 1){
    M5.Lcd.drawBitmap(yw, xw, 99, 13, windbar);
        M5.Lcd.drawRect(yw, xw + 13, 99, 30, 0x9cd3);
     if(StickCP2.BtnA.wasPressed() && y >= yw && y <= yw + 68 && x >= xw && x <= xw + 13){
w = 2;
 } 
     M5.Lcd.drawBitmap(yw, xw, 99, 13, windbar);
  if(StickCP2.BtnA.wasPressed() && y >= yw + 68 && y <= yw + 68 + 14 && x >= xw && x <= xw + 13){
  w = 3;
 } 
   if(StickCP2.BtnA.wasPressed() && y >= yw + 68 + 14 && y <= yw + 68 + 14 + 17 && x >= xw && x <= xw + 13){
  w = 0;
 } 
 }
for( ; w == 2 ; ){
    StickCP2.update();
    M5.Lcd.clear();
      M5.Imu.getAccelData(&accX, &accY, &accZ);
y = map(accY * sens * 10000, -10000, 10000, 0, 240);
x = map(accX * sens * 10000, -10000, 10000, 0, 135);
 y = constrain(y, 0, 230);
x = constrain(x, 0, 125);
  yw = y;
  xw = x;
    M5.Lcd.drawBitmap(yw, xw, 99, 13, windbar);
    if(StickCP2.BtnA.wasHold()){
w = 1;
      break;
    }
        M5.Lcd.setCursor(yw + 3, xw + 20);
          M5.Lcd.setTextSize(1);
    M5.Lcd.println("Hold BtnA to");
    M5.Lcd.setCursor(yw + 3, xw + 27);
     M5.Lcd.print("exit");
    M5.Lcd.drawRect(yw, xw + 13, 99, 30, 0x9cd3);
    delay(90);
 }
 
if(w ==3){
  M5.Lcd.clear();
  M5.Lcd.fillRect(15, 110, 10, 10, BLUE);
 if(StickCP2.BtnA.wasPressed() && y >= 15 && y <= 25 && x >= 110 && x <= 120){
   w = 1;  
  }
}

  if(M5.BtnB.wasPressed()){
    w = 1;
   xw = x;
   yw = y;
 }
  if(StickCP2.BtnA.wasPressed() && y >= yw + 68 && y <= yw + 68 + 14 && x >= xw && x <= xw + 13){
  w = 3;
 } 
 
  M5.Lcd.drawBitmap(y, x, 4, 4, cursoridl);
delay(90);
}
